## example/V1.1/Arduino_Code/Lesson14_RX_nRF2401_Wireless_RF_Module/libraries/esp-lib-utils/Kconfig
```kconfig
menu "ESP Library Utils Configurations"
    config ESP_UTILS_CONF_FILE_SKIP
        bool "Enable to skip `esp_utils_conf.h`"
        default y
        help
            If want to use `esp_utils_conf.h` to configure the library, uncheck this option. Otherwise, the configurations in sdkconfig will be used.

    if ESP_UTILS_CONF_FILE_SKIP
        menu "Check functions"
            choice ESP_UTILS_CONF_CHECK_HANDLE_METHOD_CHOICE
                prompt "Select handle method when check failed"
                default ESP_UTILS_CHECK_HANDLE_WITH_ERROR_LOG

                config ESP_UTILS_CHECK_HANDLE_WITH_NONE
                    bool "Do nothing"

                config ESP_UTILS_CHECK_HANDLE_WITH_ERROR_LOG
                    bool "Print error message"

                config ESP_UTILS_CHECK_HANDLE_WITH_ASSERT
                    bool "Assert"
            endchoice

            config ESP_UTILS_CONF_CHECK_HANDLE_METHOD
                int
                default 0 if ESP_UTILS_CHECK_HANDLE_WITH_NONE
                default 1 if ESP_UTILS_CHECK_HANDLE_WITH_ERROR_LOG
                default 2 if ESP_UTILS_CHECK_HANDLE_WITH_ASSERT
        endmenu

        menu "Log functions"
            choice ESP_UTILS_CONF_LOG_IMPL_TYPE_CHOICE
                prompt "Select log implementation"
                default ESP_UTILS_CONF_LOG_IMPL_ESP

                config ESP_UTILS_CONF_LOG_IMPL_STDLIB
                    bool "Standard (printf)"

                config ESP_UTILS_CONF_LOG_IMPL_ESP
                    bool "ESP (ESP_LOG)"
            endchoice

            config ESP_UTILS_CONF_LOG_IMPL_TYPE
                int
                default 0 if ESP_UTILS_CONF_LOG_IMPL_STDLIB
                default 1 if ESP_UTILS_CONF_LOG_IMPL_ESP

            choice ESP_UTILS_CONF_LOG_LEVEL_CHOICE
                prompt "Select global log level"
                default ESP_UTILS_CONF_LOG_LEVEL_INFO

                config ESP_UTILS_CONF_LOG_LEVEL_DEBUG
                    bool "Debug"
                    help
                        Extra information which is not necessary for normal use (values, pointers, sizes, etc)

                config ESP_UTILS_CONF_LOG_LEVEL_INFO
                    bool "Info"
                    help
                        Information messages which describe the normal flow of events

                config ESP_UTILS_CONF_LOG_LEVEL_WARNING
                    bool "Warning"
                    help
                        Error conditions from which recovery measures have been taken

                config ESP_UTILS_CONF_LOG_LEVEL_ERROR
                    bool "Error"
                    help
                        Critical errors, software module cannot recover on its own

                config ESP_UTILS_CONF_LOG_LEVEL_NONE
                    bool "None"
                    help
                        No log output
            endchoice

            config ESP_UTILS_CONF_LOG_LEVEL
                int
                default 0 if ESP_UTILS_CONF_LOG_LEVEL_DEBUG
                default 1 if ESP_UTILS_CONF_LOG_LEVEL_INFO
                default 2 if ESP_UTILS_CONF_LOG_LEVEL_WARNING
                default 3 if ESP_UTILS_CONF_LOG_LEVEL_ERROR
                default 4 if ESP_UTILS_CONF_LOG_LEVEL_NONE

            config ESP_UTILS_CONF_ENABLE_LOG_TRACE
                bool "Enable trace function"
                depends on ESP_UTILS_CONF_LOG_LEVEL_DEBUG
                default n
                help
                    If enabled, the driver will print trace log messages when enter/exit functions, useful for debugging
        endmenu

        menu "Memory functions"
            depends on ESP_UTILS_CONF_FILE_SKIP

            menu "C/C++ general allocator"
                config ESP_UTILS_CONF_MEM_GEN_ALLOC_DEFAULT_ENABLE
                    bool "Default enable allocation"
                    default y
                    help
                        If enabled, the driver will use general memory allocation by default, otherwise, the driver will use
                        the standard `malloc` and `free` by default

                choice ESP_UTILS_CONF_MEM_GEN_ALLOC_TYPE_CHOICE
                    prompt "Select allocation type"
                    default ESP_UTILS_CONF_MEM_GEN_ALLOC_TYPE_STDLIB

                    config ESP_UTILS_CONF_MEM_GEN_ALLOC_TYPE_STDLIB
                        bool "Standard (malloc, free)"

                    config ESP_UTILS_CONF_MEM_GEN_ALLOC_TYPE_ESP
                        bool "ESP (`heap_caps_malloc`, `heap_caps_free`)"

                    config ESP_UTILS_CONF_MEM_GEN_ALLOC_TYPE_MICROPYTHON
                        bool "MicroPython (`mp_malloc`, `mp_free`)"

                    config ESP_UTILS_CONF_MEM_GEN_ALLOC_TYPE_CUSTOM
                        bool "Custom (`ESP_UTILS_CONF_MEM_GEN_ALLOC_CUSTOM_NEW` and `ESP_UTILS_CONF_MEM_GEN_ALLOC_CUSTOM_DELETE`)"
                endchoice

                config ESP_UTILS_CONF_MEM_GEN_ALLOC_TYPE
                    int
                    default 0 if ESP_UTILS_CONF_MEM_GEN_ALLOC_TYPE_STDLIB
                    default 1 if ESP_UTILS_CONF_MEM_GEN_ALLOC_TYPE_ESP
                    default 2 if ESP_UTILS_CONF_MEM_GEN_ALLOC_TYPE_MICROPYTHON
                    default 3 if ESP_UTILS_CONF_MEM_GEN_ALLOC_TYPE_CUSTOM

                choice ESP_UTILS_CONF_MEM_GEN_ALLOC_ESP_CAPS_CHOICE
                    prompt "ESP memory caps"
                    depends on ESP_UTILS_CONF_MEM_GEN_ALLOC_TYPE_ESP
                    default ESP_UTILS_CONF_MEM_GEN_ALLOC_ESP_CAPS_DEFAULT

                    config ESP_UTILS_CONF_MEM_GEN_ALLOC_ESP_CAPS_DEFAULT
                        bool "Default"

                    config ESP_UTILS_CONF_MEM_GEN_ALLOC_ESP_CAPS_SRAM
                        bool "Internal RAM (SRAM)"

                    config ESP_UTILS_CONF_MEM_GEN_ALLOC_ESP_CAPS_PSRAM
                        bool "External RAM (PSRAM)"
                endchoice

                config ESP_UTILS_CONF_MEM_GEN_ALLOC_ESP_CAPS
                    int
                    default 0 if ESP_UTILS_CONF_MEM_GEN_ALLOC_ESP_CAPS_DEFAULT
                    default 1 if ESP_UTILS_CONF_MEM_GEN_ALLOC_ESP_CAPS_SRAM
                    default 2 if ESP_UTILS_CONF_MEM_GEN_ALLOC_ESP_CAPS_PSRAM

                config ESP_UTILS_CONF_MEM_GEN_ALLOC_ESP_ALIGN
                    int "ESP memory alignment (bytes)"
                    depends on ESP_UTILS_CONF_MEM_GEN_ALLOC_TYPE_ESP
                    default 1
                    range 1 1024

                config ESP_UTILS_CONF_MEM_GEN_ALLOC_CUSTOM_INCLUDE
                    string "Custom memory header file"
                    depends on ESP_UTILS_CONF_MEM_GEN_ALLOC_TYPE_CUSTOM
                    default ""
            endmenu

            menuconfig ESP_UTILS_CONF_MEM_ENABLE_CXX_GLOB_ALLOC
                bool "C++ global allocator"
                default n
                help
                    If enabled, the driver will override `new` and `delete` operators to use global memory allocator

            if ESP_UTILS_CONF_MEM_ENABLE_CXX_GLOB_ALLOC
                config ESP_UTILS_CONF_MEM_CXX_GLOB_ALLOC_DEFAULT_ENABLE
                    bool "Default enable allocation"
                    default y
                    help
                        If enabled, the driver will use global memory allocation by default, otherwise, the driver will use
                        the standard `new` and `delete` by default.

                choice ESP_UTILS_CONF_MEM_CXX_GLOB_ALLOC_TYPE_CHOICE
                    prompt "Select allocation type"
                    default ESP_UTILS_CONF_MEM_CXX_GLOB_ALLOC_TYPE_ESP

                    config ESP_UTILS_CONF_MEM_CXX_GLOB_ALLOC_TYPE_ESP
                        bool "ESP (`heap_caps_malloc`, `heap_caps_free`)"

                    config ESP_UTILS_CONF_MEM_CXX_GLOB_ALLOC_TYPE_MICROPYTHON
                        bool "MicroPython (`mp_malloc`, `mp_free`)"

                    config ESP_UTILS_CONF_MEM_CXX_GLOB_ALLOC_TYPE_CUSTOM
                        bool "Custom (`ESP_UTILS_CONF_MEM_CXX_GLOB_ALLOC_CUSTOM_NEW` and `ESP_UTILS_CONF_MEM_CXX_GLOB_ALLOC_CUSTOM_DELETE`)"
                endchoice

                config ESP_UTILS_CONF_MEM_CXX_GLOB_ALLOC_TYPE
                    int
                    default 1 if ESP_UTILS_CONF_MEM_CXX_GLOB_ALLOC_TYPE_ESP
                    default 2 if ESP_UTILS_CONF_MEM_CXX_GLOB_ALLOC_TYPE_MICROPYTHON
                    default 3 if ESP_UTILS_CONF_MEM_CXX_GLOB_ALLOC_TYPE_CUSTOM

                choice ESP_UTILS_CONF_MEM_CXX_GLOB_ALLOC_ESP_CAPS_CHOICE
                    prompt "ESP memory caps"
                    depends on ESP_UTILS_CONF_MEM_CXX_GLOB_ALLOC_TYPE_ESP
                    default ESP_UTILS_CONF_MEM_CXX_GLOB_ALLOC_ESP_CAPS_DEFAULT

                    config ESP_UTILS_CONF_MEM_CXX_GLOB_ALLOC_ESP_CAPS_DEFAULT
                        bool "Default"

                    config ESP_UTILS_CONF_MEM_CXX_GLOB_ALLOC_ESP_CAPS_SRAM
                        bool "Internal RAM (SRAM)"

                    config ESP_UTILS_CONF_MEM_CXX_GLOB_ALLOC_ESP_CAPS_PSRAM
                        bool "External RAM (PSRAM)"
                endchoice

                config ESP_UTILS_CONF_MEM_CXX_GLOB_ALLOC_ESP_CAPS
                    int
                    default 0 if ESP_UTILS_CONF_MEM_CXX_GLOB_ALLOC_ESP_CAPS_DEFAULT
                    default 1 if ESP_UTILS_CONF_MEM_CXX_GLOB_ALLOC_ESP_CAPS_SRAM
                    default 2 if ESP_UTILS_CONF_MEM_CXX_GLOB_ALLOC_ESP_CAPS_PSRAM

                config ESP_UTILS_CONF_MEM_CXX_GLOB_ALLOC_ESP_ALIGN
                    int "ESP memory alignment (bytes)"
                    depends on ESP_UTILS_CONF_MEM_CXX_GLOB_ALLOC_TYPE_ESP
                    default 1
                    range 1 1024

                config ESP_UTILS_CONF_MEM_CXX_GLOB_ALLOC_CUSTOM_INCLUDE
                    string "Custom memory header file"
                    depends on ESP_UTILS_CONF_MEM_CXX_GLOB_ALLOC_TYPE_CUSTOM
                    default ""
            endif # ESP_UTILS_CONF_MEM_ENABLE_CXX_GLOB_ALLOC
        endmenu
    endif # ESP_UTILS_CONF_FILE_SKIP
endmenu
```

## example/V1.1/idf-code/Lesson16_Get_weather_via_WiFi/sdkconfig.defaults
```kconfig
CONFIG_LV_FONT_MONTSERRAT_14=y
CONFIG_LV_FONT_MONTSERRAT_20=y
CONFIG_LV_FONT_MONTSERRAT_30=y
CONFIG_LV_FONT_MONTSERRAT_40=y

CONFIG_ESP_MAIN_TASK_STACK_SIZE=8192    # To use http and parse JSON text, a larger stack is required
```

## example/V1.2/Arduino_Code/libraries/esp-lib-utils/test_apps/sdkconfig.defaults
```kconfig
CONFIG_ESP_TASK_WDT_EN=n
CONFIG_FREERTOS_HZ=1000
CONFIG_COMPILER_CXX_EXCEPTIONS=y
CONFIG_ESP_UTILS_CONF_MEM_ENABLE_CXX_GLOB_ALLOC=y
```

## example/V1.2/idf-code/Lesson16_Get_weather_via_WiFi/components/bsp_display/Kconfig
```kconfig
menu "BSP DISPLAY Setup"
    config BSP_DISPLAY_ENABLED
        bool "Enable display functions"
        default y
    
    if BSP_DISPLAY_ENABLED
    
        config BSP_TOUCH_ENABLED
        bool "Enable touch functions"
        default y
        depends on BSP_I2C_ENABLED

        config H_SIZE
            int "Horizontal Resolution"
            default 1024

        config V_SIZE
            int "Vertical Resolution"
            default 600
      
        config BITS_PER_PIXEL
            int "Color depth"
            default 16

        config LCD_GPIO_BLIGHT
            int "GPIO For LCD BACKLIGHT"
            default 31
        
        config BLIGHT_PWM_Hz
            int "the PWM output HZ"
            default 30000

        config DISPLAY_LVGL_FULL_REFRESH
            bool "Enable fullscreen refresh"

        config DISPLAY_LVGL_DIRECT_MODE
            bool "Use screen-sized buffers"
        
        config DISPLAY_LVGL_AVOID_TEAR
            bool "Enable to avoid fragmentation"
            
        if BSP_TOUCH_ENABLED
            config TOUCH_GPIO_RST
                int "GPIO For Touch RST"
                default 40

            config TOUCH_GPIO_INT
                int "GPIO For Touch INT"
                default 42
        endif

    endif
endmenu
```

## example/V1.2/idf-code/Lesson16_Get_weather_via_WiFi/components/bsp_i2c/Kconfig
```kconfig
menu "BSP I2C Setup"
    config BSP_I2C_ENABLED
        bool "Enable I2C functions"
        default y

    if BSP_I2C_ENABLED
        config I2C_PORT_NUM
            int "I2C Master Port"
            default 0
            
        config I2C_GPIO_SCL
            int "GPIO For I2C SCL"
            default 46

        config I2C_GPIO_SDA
            int "GPIO For I2C SDA"
            default 45

        config I2C_GPIO_PULLUP
            bool "Enable I2C Pullup resistor"
            default y
        
    endif
endmenu
```

## example/V1.2/idf-code/Lesson17-Wi-Fi_function/ESP32_P4-station/sdkconfig.defaults.esp32p4
```kconfig
#
# ESP32-P4 specific
#

CONFIG_IDF_EXPERIMENTAL_FEATURES=y

CONFIG_ESPTOOLPY_FLASHMODE_QIO=y
CONFIG_ESPTOOLPY_FLASH_SAMPLE_MODE_STR=y
CONFIG_ESPTOOLPY_FLASHFREQ_80M=y
CONFIG_ESPTOOLPY_FLASHSIZE_16MB=y

CONFIG_SPIRAM=y
CONFIG_SPIRAM_MODE_HEX=y
CONFIG_SPIRAM_SPEED_200M=y

CONFIG_PARTITION_TABLE_CUSTOM=y
CONFIG_PARTITION_TABLE_CUSTOM_FILENAME="partitions.csv"
CONFIG_PARTITION_TABLE_FILENAME="partitions.csv"
CONFIG_PARTITION_TABLE_OFFSET=0x8000

CONFIG_BT_ENABLED=y
CONFIG_BT_BLUEDROID_ENABLED=y
CONFIG_BT_BLE_42_FEATURES_SUPPORTED=y

CONFIG_SLAVE_IDF_TARGET_ESP32C6=y

CONFIG_ESP_HOSTED_ENABLED=y
CONFIG_ESP_HOSTED_P4_DEV_BOARD_NONE=y

CONFIG_ESP_HOSTED_SDIO_1_BIT_BUS=y
CONFIG_ESP_HOSTED_SDIO_BUS_WIDTH=1

CONFIG_ESP_HOSTED_PRIV_SDIO_PIN_CMD_SLOT_1=19
CONFIG_ESP_HOSTED_PRIV_SDIO_PIN_CLK_SLOT_1=18
CONFIG_ESP_HOSTED_PRIV_SDIO_PIN_D0_SLOT_1=14
CONFIG_ESP_HOSTED_PRIV_SDIO_PIN_D1_1BIT_BUS_SLOT_1=15
CONFIG_ESP_HOSTED_SDIO_GPIO_RESET_SLAVE=32
```
